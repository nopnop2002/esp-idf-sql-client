## main/Kconfig.projbuild
```kconfig
menu "Application Configuration"

	config ESP_WIFI_SSID
		string "WiFi SSID"
		default "myssid"
		help
			SSID (network name) for the example to connect to.

	config ESP_WIFI_PASSWORD
		string "WiFi Password"
		default "mypassword"
		help
			WiFi password (WPA or WPA2) for the example to use.

	config ESP_MAXIMUM_RETRY
		int "Maximum retry"
		default 5
		help
			Set the Maximum retry to avoid station reconnecting to the AP unlimited when the AP is really inexistent.

	config ESP_WEB_SERVER_IP
		string "IP address of WEB server"
		default "192.168.10.43"
		help
			IP address of your WEB server.

	config ESP_WEB_SERVER_PORT
		string "Port number of WEB serve"
		default "8080"
		help
			Port number of your WEB server.

	config ESP_PHP_PATH
		string "Path of php script"
		default "api.php/records/posts"
		help
			Path of php script.

endmenu
```
